## CMakeLists.txt
```
# SPDX-License-Identifier: Apache-2.0

cmake_minimum_required(VERSION 3.20.0)
find_package(Zephyr REQUIRED HINTS $ENV{ZEPHYR_BASE})
project(spi_flash)

FILE(GLOB app_sources src/*.c)
target_sources(app PRIVATE ${app_sources})


# add gnss_module (the unit under test)
target_sources(app PRIVATE ../../src/FlashSPI.c)
target_sources(app PRIVATE ../../src/AES_CTR.c)
target_sources(app PRIVATE ../../src/PIN_CTRL.c)
target_sources(app PRIVATE ../../src/MQTT_Queue.c)
target_sources(app PRIVATE ../../src/Com_State_Machine.c)
target_sources(app PRIVATE ../../src/bg95.c)
target_sources(app PRIVATE ../../src/Comm_Mgr.c)
target_sources(app PRIVATE ../../src/thuraya.c)
target_sources(app PRIVATE ../../src/GPS.c)
target_sources(app PRIVATE ../../src/lock.c)
target_sources(app PRIVATE ../../src/NRF_SM.c)
target_sources(app PRIVATE ../../src/BLE_mgr.c)




target_include_directories(app PRIVATE .)
target_include_directories(app PRIVATE ../../src/)
```

## prj.conf
```kconfig
# Ensure an MCUboot-compatible binary is generated.
CONFIG_NCS_SAMPLES_DEFAULTS=y

CONFIG_BT=y
CONFIG_BT_PERIPHERAL=y
CONFIG_BT_DEVICE_NAME="Nordic_LBS"

CONFIG_BT=y
CONFIG_BT_BROADCASTER=y
CONFIG_BT_OBSERVER=y
CONFIG_BT_DEBUG_LOG=y
CONFIG_BT_PERIPHERAL=y
CONFIG_BT_LL_SW_SPLIT=y
CONFIG_BT_GATT_CLIENT=y

CONFIG_MAIN_STACK_SIZE=4096

CONFIG_NFCT_PINS_AS_GPIOS=y
CONFIG_GPIO_AS_PINRESET=n
CONFIG_UART_INTERRUPT_DRIVEN=y
CONFIG_BOARD_ENABLE_DCDC=n
CONFIG_CLOCK_CONTROL_NRF_K32SRC_RC=y
CONFIG_CLOCK_CONTROL_NRF_K32SRC_XTAL=n

CONFIG_PM=y
CONFIG_PM_DEVICE=y

CONFIG_GPIO=y
CONFIG_NRFX_WDT=y
CONFIG_WATCHDOG=y

CONFIG_ADC=y


# Enable the LBS service
CONFIG_BT_LBS=y
CONFIG_BT_LBS_POLL_BUTTON=y
CONFIG_DK_LIBRARY=y

CONFIG_SYSTEM_WORKQUEUE_STACK_SIZE=2048


#CONFIG_BOOTLOADER_MCUBOOT=y
CONFIG_LOG=y

CONFIG_SYSTEM_WORKQUEUE_STACK_SIZE=4096

CONFIG_NORDIC_QSPI_NOR=n

CONFIG_FLASH=y
CONFIG_SPI=y
CONFIG_SPI_NOR=y
CONFIG_SPI_NOR_FLASH_LAYOUT_PAGE_SIZE=4096
CONFIG_SPI_NRFX_RAM_BUFFER_SIZE=32 

# Enable mcumgr.
CONFIG_MCUMGR=y

# Enable most core commands.
CONFIG_MCUMGR_CMD_IMG_MGMT=y
CONFIG_MCUMGR_CMD_OS_MGMT=y

# Ensure an MCUboot-compatible binary is generated.
#CONFIG_BOOTLOADER_MCUBOOT=y

# Allow for large Bluetooth data packets.
CONFIG_BT_L2CAP_TX_MTU=252
CONFIG_BT_BUF_ACL_RX_SIZE=256

# Enable the Bluetooth (unauthenticated) and shell mcumgr transports.
CONFIG_MCUMGR_SMP_BT=y
CONFIG_MCUMGR_SMP_BT_AUTHEN=n

# Some command handlers require a large stack.
CONFIG_SYSTEM_WORKQUEUE_STACK_SIZE=4096


CONFIG_BOARD_ENABLE_DCDC=n
CONFIG_CLOCK_CONTROL_NRF_K32SRC_RC=y
CONFIG_CLOCK_CONTROL_NRF_K32SRC_XTAL=n
CONFIG_RTT_CONSOLE=y
CONFIG_UART_CONSOLE=n
CONFIG_JSON_LIBRARY=y

CONFIG_TINYCRYPT=y
CONFIG_TINYCRYPT_AES=y
CONFIG_TINYCRYPT_AES_CBC=y
CONFIG_CRYPTO=y
CONFIG_CRYPTO_TINYCRYPT_SHIM=y

CONFIG_BT_FILTER_ACCEPT_LIST=y
CONFIG_BT_CENTRAL=y
CONFIG_BT_SCAN=y
CONFIG_BT_SCAN_FILTER_ENABLE=y
CONFIG_BT_SCAN_NAME_CNT=1

CONFIG_ZTEST=y
CONFIG_ZTEST_ASSERT_VERBOSE=0
```

## src/main.c
```c
#include <zephyr.h>
#include <drivers/flash.h>
#include <device.h>
#include <devicetree.h>
#include <stdio.h>
#include <string.h>
#include <drivers/gpio.h>
#include "FlashSPI.h"
#include "MQTT_Queue.h"
#include "PIN_CTRL.h"
#include "NRF_SM.h"
#include <ztest.h>
#include <ztest_assert.h>
#include "bg95.h"
#include "BG95_WIFI_CONFIG.h"

/* Global timers to be manipulated from timer expire function and sleep cycles */
unsigned long epoch;
uint16_t ReportTimer = 0;
uint16_t gpsTimer = 0;
uint16_t BLETimer = 0;
uint32_t secCnt = 1;
/* Global Configurations to be mainpulated by different communication modules */
uint16_t report_total_period_minutes;
uint32_t BT_INT_VALUE;
uint16_t BT_DUR_VALUE;
uint16_t GPS_INT_VALUE;
uint16_t ALARMS_INT_VALUE;
uint16_t GPS_TRIALS_VALUE;
uint8_t Set_Mode = Demo_mode;
uint8_t Scan_Interval = BT_INT_1min;
uint8_t Scan_Duration = BT_DUR_5sec;
uint8_t GPS_Interval = GPS_INT_5min;

uint8_t ALARMS_Interval = ALARMS_INT_5min;
uint16_t alarmsTimer = 1440;

uint8_t GPS_Duration = GPS_TRIALS_5;
uint8_t Communication_Priority = COMM_NORMAL;
char WIFI_Password[50];
char WIFI_UserName[50];
char IP[128];
char config[10] = "010010";

/* Thresholds */
int ET = 1;
int Limit_humidity_H = 80;
int Limit_humidity_L = 5;
int Limit_temperature_H = 40;
int Limit_temperature_L = 0;
int Limit_light_H = 200;
int Limit_light_L = 5;
int Firmware_Reset = 0;
bool Tampering_Flag = false;

bool OTAupdate = false;
bool Restart_Version = true;
bool PCCW_ICCID_FLAG = false;
bool SATCOM_ICCID_FLAG = false;
bool Restart_Version_Thuraya = true;

extern Assigned_Tags my_Tags;

extern stMQTTfifo_t myMQTTfifo;
extern const struct device *dev2;
uint8_t BG95_State_test = 1;
uint8_t GPS_State_test = 1;
extern stCmd_t BG95_CR;
extern stMQTT_t_NRF *myM_NRF;

uint8_t parseCmd3(stCmd_t *stCR, unsigned char Ch)
{
	return 1;
}
int test_case_1()
{
	int err;
	uint8_t last_BG95_State_test = 1;
	uint8_t messages_counter = 0;
	bool flag = true;
	int logged_messages_for_testing = 70;
	BG95_State_test = 1;
	for (int i = 0; i < logged_messages_for_testing; i++) {
		myM_NRF = &myMQTTfifo.myMQTT[myMQTTfifo.EndPtr];
		myM_NRF->Message.stData.epoch = epoch;
		myM_NRF->Message.stData.latH_lbs = 30;
		myM_NRF->Message.stData.latL_lbs = 30;
		myM_NRF->Message.stData.lngH_lbs = 30;
		myM_NRF->Message.stData.lngL_lbs = 30;
		MQTT_PushFIFO(1);
	}
	while (BG95_State_test != BG95_STATE_REPORT_SUCCESSFUL) {
		BG95_State_test = BG95_StateMachine(&BG95_CR, BG95_State_test);
		if (BG95_State_test == BG95_QMTPUB && last_BG95_State_test != BG95_QMTPUB)
			messages_counter++;
		/* trying to insert messages with full fifo just imported*/
		if (messages_counter == 3 && flag) {
			flag = false;
			printk("adding extra messages\r\n");
			myM_NRF = &myMQTTfifo.myMQTT[myMQTTfifo.EndPtr];
			myM_NRF->Message.stData.epoch = epoch;
			myM_NRF->Message.stData.latH_lbs = 30;
			myM_NRF->Message.stData.latL_lbs = 30;
			myM_NRF->Message.stData.lngH_lbs = 30;
			myM_NRF->Message.stData.lngL_lbs = 30;
			MQTT_PushFIFO(1);
			myM_NRF = &myMQTTfifo.myMQTT[myMQTTfifo.EndPtr];
			myM_NRF->Message.stData.epoch = epoch;
			myM_NRF->Message.stData.latH_lbs = 30;
			myM_NRF->Message.stData.latL_lbs = 30;
			myM_NRF->Message.stData.lngH_lbs = 30;
			myM_NRF->Message.stData.lngL_lbs = 30;
			MQTT_PushFIFO(1);
		}

		last_BG95_State_test = BG95_State_test;

		k_msleep(10);
	}
	printk("messages counter = %d \r\n", messages_counter);
	zassert_true(messages_counter > logged_messages_for_testing,
		     "all logged messages are sent");
	zassert_true(epoch > 1687775859, "Wrong epoch!\r\n");
	zassert_mem_equal(PCCW_ICCID, "8985200015505021543F", sizeof("8985200015505021543F"),
			  "Wrong SIM Card parse\r\n");
	zassert_mem_equal(IMEI, "869616064626297", sizeof("869616064626297"),
			  "WRONG IMEI parse \r\n");
	zassert_mem_equal(config, "01131003", sizeof("01131003"), "WRONG subs config parse \r\n");
	zassert_true(pointersDiff() == 0, "still messsages inside\r\n");
}

void test_case_2()
{
	uint8_t last_GPS_State_test = 1;
	GPS_State_test = 1;
	GPS_TRIALS_VALUE = 1;
	epoch = 0;
	stMQTT_t_NRF *myM_NRF;
	myM_NRF = &myMQTTfifo.myMQTT[myMQTTfifo.EndPtr - 1];
	while (GPS_State_test != GPS_CONFIRM_PWR_DWN) {
		GPS_State_test = GPS_StateMachine(&BG95_CR, GPS_State_test);
		k_msleep(10);
	}
	myM_NRF = &myMQTTfifo.myMQTT[myMQTTfifo.EndPtr - 1];
	zassert_true(myM_NRF->Message.stData.latH_lbs == 30, "should be 30 in office\r\n");
	zassert_true(myM_NRF->Message.stData.lngH_lbs == 31, "should be 31 in office\r\n");
	zassert_true(pointersDiff() == 1, "should get only 1 position\r\n");
	zassert_true(epoch > 1687775859, "Wrong epoch!\r\n");
}

void test_case_3()
{
	BLE_INIT();
	MQTT_InitFIFO();
	strcpy(my_Tags.Tags_Info.Ble_CyTag_Ids[0], "D1:AE:FE:58:30:64");
	start_scan();
	k_msleep(10000);
	bt_le_scan_stop();
	myM_NRF = &myMQTTfifo.myMQTT[myMQTTfifo.EndPtr - 1];
	zassert_true(pointersDiff() == 1, "should get only 1 position\r\n");
	zassert_true(myM_NRF->Message.stData.Hum_High > 10 && myM_NRF->Message.stData.Hum_High < 70,
		     "humidity in range\r\n");
	zassert_true(myM_NRF->Message.stData.Temp_High > 10 &&
			     myM_NRF->Message.stData.Temp_High < 40,
		     "humidity in range\r\n");
	zassert_ok(strcmp(myM_NRF->Message.stData.TagID, "D1:AE:FE:58:30:64"),
		   "correct tag ID\r\n");
}

void test_main(void)
{
	int err;
	GPIO_INIT();
	MQTT_InitFIFO();
	err = FLASH_INIT();
	COMM_MGR_INIT();
	strcpy(IP, "\"104.218.120.206\",8443");

	gpio_pin_set(dev2, 7, 1);
	gpio_pin_set(dev2, 8, 0);
	if (err) {
		printk("test failed\n");
		while (1)
			;
	}

	ztest_test_suite(framework_tests, ztest_unit_test(test_case_1),
			 //  ztest_unit_test(test_case_2));
			 ztest_unit_test(test_case_2), ztest_unit_test(test_case_3));

	ztest_run_test_suite(framework_tests);
}
```
